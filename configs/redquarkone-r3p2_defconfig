## configs/redquarkone-r3p2_defconfig
```kconfig
BR2_JLEVEL=16

# Architecture
BR2_arm=y
BR2_cortex_a7=y
BR2_ARM_EABIHF=y

BR2_TOOLCHAIN_BUILDROOT_GLIBC=y
BR2_TOOLCHAIN_BUILDROOT_CXX=y
BR2_INSTALL_LIBSTDCPP=y

# Linux headers same as kernel, a 3.4 series
BR2_PACKAGE_HOST_LINUX_HEADERS_CUSTOM_3_4=y

# System configuration
BR2_TARGET_GENERIC_HOSTNAME="redquarkone"
BR2_TARGET_GENERIC_ISSUE="RedQuark One - Dev"
BR2_TARGET_GENERIC_GETTY=y
BR2_TARGET_GENERIC_GETTY_PORT="ttyS0"
BR2_ROOTFS_POST_BUILD_SCRIPT="board/redquark/redquarkone/post-build.sh"
BR2_ROOTFS_POST_IMAGE_SCRIPT="board/redquark/redquarkone/post-image.sh"
BR2_ROOTFS_POST_SCRIPT_ARGS="board/redquark/redquarkone/boot-mali.cmd $(TARGET_DIR)/boot"

# Kernel
BR2_LINUX_KERNEL=y
BR2_LINUX_KERNEL_CUSTOM_GIT=y
BR2_LINUX_KERNEL_CUSTOM_REPO_URL="git@github.com:zxchris/linux-sunxi.git"
BR2_LINUX_KERNEL_CUSTOM_REPO_VERSION="add-mali-r3p2"
##BR2_LINUX_KERNEL_CUSTOM_REPO_URL="git@github.com:mireq/linux-sunxi.git"
##BR2_LINUX_KERNEL_CUSTOM_REPO_VERSION="sunxi-3.4"
#BR2_LINUX_KERNEL_CUSTOM_REPO_URL="git@github.com:dan-and/linux-sunxi.git"
#BR2_LINUX_KERNEL_CUSTOM_REPO_VERSION="dan-3.4.105"
BR2_LINUX_KERNEL_USE_CUSTOM_CONFIG=y
BR2_LINUX_KERNEL_CUSTOM_CONFIG_FILE="board/redquark/redquarkone/linux_3.4.r3p2.config"
#BR2_LINUX_KERNEL_USE_DEFCONFIG=n
#BR2_LINUX_KERNEL_DEFCONFIG="sun7i"
BR2_LINUX_KERNEL_INSTALL_TARGET=y

BR2_ROOTFS_OVERLAY="board/redquark/redquarkone/rootfs-overlay"

# Device management
BR2_ROOTFS_DEVICE_CREATION_DYNAMIC_MDEV=y
BR2_ROOTFS_DEVICE_TABLE="system/device_table.txt"

BR2_SHARED_STATIC_LIBS=y

# sunxi packages
BR2_PACKAGE_SUNXI_TOOLS=y
BR2_PACKAGE_SUNXI_BOARDS=y
BR2_PACKAGE_SUNXI_BOARDS_FEX_FILE="a20/redquarkone.fex"
BR2_PACKAGE_ZXCHRIS_MALI=y
BR2_PACKAGE_ZXCHRIS_MALI_R3P2=y
BR2_PACKAGE_ZXCHRIS_MALI_DBG=y
BR2_PACKAGE_A10DISP=y

# Filesystem
BR2_TARGET_ROOTFS_EXT2=y
BR2_TARGET_ROOTFS_EXT2_4=y
# BR2_TARGET_ROOTFS_TAR is not set

# Bootloaders
BR2_TARGET_UBOOT=y
BR2_TARGET_UBOOT_BUILD_SYSTEM_KCONFIG=y
BR2_TARGET_UBOOT_CUSTOM_GIT=y
BR2_TARGET_UBOOT_CUSTOM_REPO_URL="git@github.com:zxchris/u-boot.git"
BR2_TARGET_UBOOT_CUSTOM_REPO_VERSION="redquarkone"
BR2_TARGET_UBOOT_BOARD_DEFCONFIG="A20-Redquarkone"
BR2_TARGET_UBOOT_NEEDS_DTC=y

## Bootloaders
#BR2_TARGET_UBOOT=y
## UBoot >= 2015.04
#BR2_TARGET_UBOOT_BUILD_SYSTEM_KCONFIG=y
#BR2_TARGET_UBOOT_CUSTOM_VERSION=y
#BR2_TARGET_UBOOT_BOARD_DEFCONFIG="A20-OLinuXino-Lime"
#BR2_TARGET_UBOOT_CUSTOM_VERSION_VALUE="2017.03"
#BR2_TARGET_UBOOT_NEEDS_DTC=y

## UBoot <  2015.04
#BR2_TARGET_UBOOT_BUILD_SYSTEM_LEGACY=y
#BR2_TARGET_UBOOT_CUSTOM_GIT=y
#BR2_TARGET_UBOOT_CUSTOM_REPO_URL="https://github.com/zxchris/u-boot-sunxi.git"
#BR2_TARGET_UBOOT_CUSTOM_REPO_VERSION="v2014-redquark-0.1"
#BR2_TARGET_UBOOT_BOARDNAME="sun7i"
## Perhaps supplu our own UBOOT xxxx_config
##BR2_TARGET_UBOOT_USE_CUSTOM_CONFIG=

BR2_TARGET_UBOOT_FORMAT_BIN=y
BR2_TARGET_UBOOT_SPL=y
BR2_TARGET_UBOOT_SPL_NAME="u-boot-sunxi-with-spl.bin"

# Additional tools
BR2_PACKAGE_HOST_GENIMAGE=y
BR2_PACKAGE_HOST_UBOOT_TOOLS=y

BR2_PACKAGE_ALSA_LIB=y
BR2_PACKAGE_LIBEVDEV=y
BR2_PACKAGE_ZLIB=y
BR2_PACKAGE_LIBUMP=y
BR2_PACKAGE_LIBPNG=y
BR2_PACKAGE_JPEG=y
BR2_PACKAGE_LIBJPEG=y

BR2_PACKAGE_REDQUARK=y
```

## configs/redquarkone_defconfig
```kconfig
# Architecture
BR2_arm=y
BR2_cortex_a7=y
BR2_ARM_EABIHF=y

BR2_TOOLCHAIN_BUILDROOT_GLIBC=y

# Linux headers same as kernel, a 3.4 series
BR2_PACKAGE_HOST_LINUX_HEADERS_CUSTOM_3_4=y

# System configuration
BR2_TARGET_GENERIC_HOSTNAME="redquarkone"
BR2_TARGET_GENERIC_ISSUE="RedQuark One - Dev"
BR2_TARGET_GENERIC_GETTY=y
BR2_TARGET_GENERIC_GETTY_PORT="ttyS0"
BR2_ROOTFS_POST_BUILD_SCRIPT="board/redquark/redquarkone/post-build.sh"
BR2_ROOTFS_POST_IMAGE_SCRIPT="board/redquark/redquarkone/post-image.sh"
BR2_ROOTFS_POST_SCRIPT_ARGS="board/redquark/redquarkone/boot-mali.cmd $(TARGET_DIR)/boot"

# Kernel
BR2_LINUX_KERNEL=y
BR2_LINUX_KERNEL_CUSTOM_GIT=y
BR2_LINUX_KERNEL_CUSTOM_REPO_URL="https://github.com/dan-and/linux-sunxi.git"
# based on Linux version 3.4.113
BR2_LINUX_KERNEL_CUSTOM_REPO_VERSION="fc385cc6dfa350382ecc94a520a716b57e654410"
BR2_LINUX_KERNEL_USE_CUSTOM_CONFIG=y
BR2_LINUX_KERNEL_CUSTOM_CONFIG_FILE="board/redquark/redquarkone/linux_3.4.v2.config"
#BR2_LINUX_KERNEL_USE_DEFCONFIG=n
#BR2_LINUX_KERNEL_DEFCONFIG="sun7i"
BR2_LINUX_KERNEL_INSTALL_TARGET=y

BR2_ROOTFS_OVERLAY="board/redquark/redquarkone/rootfs-overlay"

# Device management
BR2_ROOTFS_DEVICE_CREATION_DYNAMIC_MDEV=y
BR2_ROOTFS_DEVICE_TABLE="system/device_table.txt"

# sunxi packages
BR2_PACKAGE_SUNXI_TOOLS=y
BR2_PACKAGE_SUNXI_BOARDS=y
BR2_PACKAGE_SUNXI_BOARDS_FEX_FILE="a20/a20-olinuxino_lime.fex"
BR2_PACKAGE_SUNXI_MALI=y
BR2_PACKAGE_SUNXI_MALI_DBG=y
BR2_PACKAGE_A10DISP=y

# Filesystem
BR2_TARGET_ROOTFS_EXT2=y
BR2_TARGET_ROOTFS_EXT2_4=y
# BR2_TARGET_ROOTFS_TAR is not set

# Bootloaders
BR2_TARGET_UBOOT=y
BR2_TARGET_UBOOT_BUILD_SYSTEM_KCONFIG=y
BR2_TARGET_UBOOT_CUSTOM_VERSION=y
BR2_TARGET_UBOOT_CUSTOM_VERSION_VALUE="2017.03"
BR2_TARGET_UBOOT_BOARD_DEFCONFIG="A20-OLinuXino-Lime"
BR2_TARGET_UBOOT_NEEDS_DTC=y
BR2_TARGET_UBOOT_FORMAT_BIN=y
BR2_TARGET_UBOOT_SPL=y
BR2_TARGET_UBOOT_SPL_NAME="u-boot-sunxi-with-spl.bin"

# Additional tools
BR2_PACKAGE_HOST_GENIMAGE=y
BR2_PACKAGE_HOST_UBOOT_TOOLS=y

BR2_PACKAGE_ALSA_LIB=y
BR2_PACKAGE_LIBEVDEV=y
BR2_PACKAGE_ZLIB=y
BR2_PACKAGE_LIBUMP=y
BR2_PACKAGE_LIBPNG=y
```

## package/redquark/Config.in
```kconfig
config BR2_PACKAGE_REDQUARK
	bool "redquark"
    depends on BR2_INSTALL_LIBSTDCPP
    depends on BR2_TOOLCHAIN_HAS_THREADS
    select BR2_PACKAGE_FREETYPE
    select BR2_PACKAGE_ZLIB
    select BR2_PACKAGE_LIBPNG
    #select BR2_PACKAGE_SUNXI_MALI
    select BR2_PACKAGE_ZXCHRIS_MALI
    select BR2_PACKAGE_HARFBUZZ
    select BR2_PACKAGE_LIBEVDEV
    select BR2_PACKAGE_ALSA_LIB
    select BR2_PACKAGE_JPEG
	help
      Redquark core UI and engine
```

## package/the64/Config.in
```kconfig
config BR2_PACKAGE_THE64
	bool "the64"
    depends on BR2_INSTALL_LIBSTDCPP
    depends on BR2_TOOLCHAIN_HAS_THREADS
    select BR2_PACKAGE_FREETYPE
    select BR2_PACKAGE_ZLIB
    select BR2_PACKAGE_LIBPNG
    select BR2_PACKAGE_SUNXI_MALI
    select BR2_PACKAGE_HARFBUZZ
    select BR2_PACKAGE_LIBEVDEV
    select BR2_PACKAGE_ALSA_LIB
    select BR2_PACKAGE_JPEG
	help
      The64 core UI and Commodore 64 emulation.

	  http://the64.computer
```

## package/zxchris-mali/Config.in
```kconfig
config BR2_PACKAGE_ZXCHRIS_MALI
	bool "zxchris-mali"
	select BR2_PACKAGE_HAS_LIBEGL
	select BR2_PACKAGE_HAS_LIBGLES
	select BR2_PACKAGE_LIBUMP
	depends on BR2_TOOLCHAIN_USES_GLIBC
	depends on BR2_arm
	help
	  Install the ARM Mali drivers for sunxi based systems (i.e
	  systems based on ARM Allwinner SoCs). This driver requires
	  either the sunxi-kernel with the ARM Mali driver enabled or
	  the installation of the ARM Mali drivers as an external
	  module.

	  http://github.com/zxchris/sunxi-mali

if BR2_PACKAGE_ZXCHRIS_MALI

config BR2_PACKAGE_PROVIDES_LIBEGL
	default "zxchris-mali"

config BR2_PACKAGE_PROVIDES_LIBGLES
	default "zxchris-mali"

config BR2_PACKAGE_ZXCHRIS_MALI_DBG
	bool "install malitest and maliver tools"
	help
	  Install 3D triangle demo malitest application and the maliver application
	  which describes the kernel module version.

choice
	prompt "Version"
	default BR2_PACKAGE_ZXCHRIS_MALI_R3P0
	help
	  Select the version of the kernel module. For the sunxi-kernel, the
	  appropriate version number is r3p0. For other kernels, use the maliver
	  application to determine the appropriate version.

config BR2_PACKAGE_ZXCHRIS_MALI_R2P4
	bool "r2p4"
	depends on BR2_ARM_EABI

comment "r2p4 requires an EABI toolchain"
	depends on !BR2_ARM_EABI

config BR2_PACKAGE_ZXCHRIS_MALI_R3P0
	bool "r3p0"
	depends on BR2_ARM_EABIHF

comment "r3p0 requires an EABIhf toolchain"
	depends on !BR2_ARM_EABIHF

config BR2_PACKAGE_ZXCHRIS_MALI_R3P1
	depends on BR2_ARM_EABIHF
	bool "r3p1"

comment "r3p1 requires an EABIhf toolchain"
	depends on !BR2_ARM_EABIHF

config BR2_PACKAGE_ZXCHRIS_MALI_R3P2
	depends on BR2_ARM_EABIHF
	bool "r3p2"

comment "r3p2 requires an EABIhf toolchain"
	depends on !BR2_ARM_EABIHF

config BR2_PACKAGE_ZXCHRIS_MALI_R4P0
	depends on BR2_ARM_EABIHF
	bool "r4p0"

comment "r4p0 requires an EABIhf toolchain"
	depends on !BR2_ARM_EABIHF

endchoice

endif

comment "zxchris-mali needs a glibc toolchain"
	depends on BR2_arm
	depends on !BR2_TOOLCHAIN_USES_GLIBC
```
